## device_firmware/1_blink/main/Kconfig.projbuild
```kconfig
menu "Example Configuration"

    config BLINK_GPIO
        int "Blink GPIO number"
        range 0 48 if IDF_TARGET_ESP32S3
        range 0 21 if IDF_TARGET_ESP32C3
        range 0 48
        default 48 if IDF_TARGET_ESP32S3
        default 5 if IDF_TARGET_ESP32C3
        default 5
        help
            GPIO number (IOxx) to blink on and off.

            On ESP32-S3 DevKit boards, GPIO 48 is commonly connected to RGB LED, or discrete GPIOs.
            On ESP32-C3 DevKit boards, GPIO 5 (or GPIO 8) is commonly used.

endmenu
```

## device_firmware/3_wifi_connection/main/Kconfig.projbuild
```kconfig
menu "Example Configuration"

    config ESP_WIFI_SSID
        string "WiFi SSID"
        default "Minh Toan"
        help
            SSID (network name) for the example to connect to.

    config ESP_WIFI_PASSWORD
        string "WiFi Password"
        default "14052004"
        help
            WiFi password (WPA or WPA2) for the example to use.

    config ESP_WIFI_BSSID
        string "WiFi BSSID (MAC Address)"
        default ""
        help
            Optional BSSID (MAC address) of the AP in format XX:XX:XX:XX:XX:XX.
            Leave empty to automatically discover and lock to the strongest 2.4GHz BSSID.

    config ESP_MAXIMUM_RETRY
        int "Maximum retry"
        default 10
        help
            Set the Maximum retry to avoid station reconnecting to the AP unlimited when the AP is off.

endmenu
```

## device_firmware/4_network_config/sdkconfig.defaults
```kconfig
# Espressif IoT Development Framework (ESP-IDF) Project Configuration
CONFIG_IDF_TARGET="esp32c3"
CONFIG_IDF_TARGET_ESP32C3=y

# Serial flasher config
CONFIG_ESPTOOLPY_FLASHSIZE_4MB=y
CONFIG_PARTITION_TABLE_SINGLE_APP=n
CONFIG_PARTITION_TABLE_TWO_OTA=n
CONFIG_PARTITION_TABLE_CUSTOM=y
CONFIG_PARTITION_TABLE_CUSTOM_FILENAME="partitions.csv"
CONFIG_PARTITION_TABLE_FILENAME="partitions.csv"
CONFIG_PARTITION_TABLE_OFFSET=0x8000
CONFIG_PARTITION_TABLE_MD5=y

# mbedtls
CONFIG_MBEDTLS_DYNAMIC_BUFFER=y
CONFIG_MBEDTLS_DYNAMIC_FREE_PEER_CERT=y
CONFIG_MBEDTLS_DYNAMIC_FREE_CONFIG_DATA=y

# For BLE Provisioning using NimBLE stack (Not applicable for ESP32-S2)
CONFIG_BT_ENABLED=y
CONFIG_BTDM_CTRL_MODE_BLE_ONLY=y
CONFIG_BT_NIMBLE_ENABLED=y

# Protocomm Security & Wi-Fi Provisioning
CONFIG_ESP_PROTOCOMM_SUPPORT_SECURITY_VERSION_0=y
CONFIG_ESP_PROTOCOMM_SUPPORT_SECURITY_VERSION_1=y
CONFIG_ESP_PROTOCOMM_SUPPORT_SECURITY_VERSION_2=y
CONFIG_NETWORK_PROV_NETWORK_TYPE_WIFI=y

# Temporary Fix for Timer Overflows
CONFIG_FREERTOS_TIMER_TASK_STACK_DEPTH=3120
```

## device_firmware/5_rainmaker/main/Kconfig.projbuild
```kconfig
menu "ESP RainMaker OTA Configuration (Chapter 11)"

    choice APP_OTA_MODE
        prompt "RainMaker OTA Workflow Mode"
        default APP_OTA_USING_PARAMS
        help
            Select the OTA mechanism: URL Parameters (development/local)
            or MQTT Topics (RainMaker Cloud Dashboard).

        config APP_OTA_USING_PARAMS
            bool "OTA Using Parameters (URL via CLI/API)"
            help
                Enable OTA upgrade triggered by setting the OTA URL parameter.
                Suitable for local testing, private HTTPS servers, or CLI commands.

        config APP_OTA_USING_TOPICS
            bool "OTA Using Topics (Dashboard OTA Jobs)"
            help
                Enable OTA upgrade coordinated via MQTT topics and RainMaker Dashboard.
                Suitable for production batch deployments.
    endchoice

endmenu
```

## device_firmware/7_insights/sdkconfig.defaults
```kconfig
CONFIG_IDF_CMAKE=y

CONFIG_ESPTOOLPY_FLASHSIZE_4MB=y
CONFIG_PARTITION_TABLE_CUSTOM=y
CONFIG_PARTITION_TABLE_CUSTOM_FILENAME="partitions.csv"
CONFIG_PARTITION_TABLE_FILENAME="partitions.csv"
CONFIG_PARTITION_TABLE_OFFSET=0x8000
CONFIG_PARTITION_TABLE_MD5=y

# mbedtls
CONFIG_MBEDTLS_DYNAMIC_BUFFER=y
CONFIG_MBEDTLS_DYNAMIC_FREE_PEER_CERT=y
CONFIG_MBEDTLS_DYNAMIC_FREE_CONFIG_DATA=y

# NimBLE stack for BLE Provisioning
CONFIG_BT_ENABLED=y
CONFIG_BTDM_CTRL_MODE_BLE_ONLY=y
CONFIG_BT_NIMBLE_ENABLED=y

# Bootloader App Rollback (Chapter 11)
CONFIG_BOOTLOADER_APP_ROLLBACK_ENABLE=y

# Power Management (Chapter 12)
CONFIG_PM_ENABLE=y
CONFIG_FREERTOS_USE_TICKLESS_IDLE=y
CONFIG_PM_SLP_DISABLE_GPIO=y

# Local Control auto enable
CONFIG_ESP_RMAKER_LOCAL_CTRL_AUTO_ENABLE=y

# FreeRTOS Timer Stack
CONFIG_FREERTOS_TIMER_TASK_STACK_DEPTH=3120

# ESP Insights (Chapter 15)
CONFIG_ESP_INSIGHTS_ENABLED=y

# Core Dump to Flash (ESP-IDF v6.0.2 format)
CONFIG_ESP_COREDUMP_ENABLE=y
CONFIG_ESP_COREDUMP_ENABLE_TO_FLASH=y
CONFIG_ESP_COREDUMP_DATA_FORMAT_ELF=y
CONFIG_ESP_COREDUMP_CHECKSUM_CRC32=y
CONFIG_ESP_COREDUMP_MAX_TASKS_NUM=64
CONFIG_ESP_COREDUMP_STACK_SIZE=1024

# Diagnostics Metrics & Variables
CONFIG_DIAG_ENABLE_METRICS=y
CONFIG_DIAG_ENABLE_HEAP_METRICS=y
CONFIG_DIAG_ENABLE_WIFI_METRICS=y
CONFIG_DIAG_ENABLE_VARIABLES=y
CONFIG_DIAG_ENABLE_NETWORK_VARIABLES=y
```

## test_case/advanced_https_ota/main/Kconfig.projbuild
```kconfig
menu "Example Configuration"

    config EXAMPLE_FIRMWARE_UPGRADE_URL
        string "Firmware Upgrade URL"
        default "https://192.168.1.100:8070/firmware.bin"
        help
            URL of server which hosts the firmware image.

    config EXAMPLE_OTA_CHECK_INTERVAL
        int "Delay between OTA checks (seconds)"
        range 10 3600
        default 30
        help
            Wait this long after connecting, then between failed or same-version checks.

    config EXAMPLE_OTA_RECV_TIMEOUT
        int "OTA Receive Timeout"
        range 1000 120000
        default 15000
        help
            Maximum time for reception

endmenu
```

## test_case/broadcast_discovery/main/Kconfig.projbuild
```kconfig
menu "Broadcast Discovery Configuration"

    config BROADCAST_WIFI_SSID
        string "Wi-Fi SSID"
        default "Minh Toan"
        help
            SSID of the Access Point to connect to for Broadcast Discovery.

    config BROADCAST_WIFI_PASSWORD
        string "Wi-Fi Password"
        default "21012004"
        help
            Password of the Access Point to connect to.

    config BROADCAST_MAX_RETRY
        int "Maximum Wi-Fi Connection Retries"
        default 10
        help
            Number of retries before reporting Wi-Fi connection failure.

    config BROADCAST_PORT
        int "UDP Broadcast Discovery Port"
        default 3333
        help
            UDP port used for broadcasting and listening.

    config BROADCAST_IS_CLIENT
        bool "Run as Discovery Client/Sender (Default is Device/Receiver)"
        default n
        help
            When enabled, sends broadcast query packet to discover lights.
            When disabled (default), listens on port 3333 as the Smart Light device.

endmenu
```

## test_case/coap/main/Kconfig.projbuild
```kconfig
menu "CoAP Configuration"

    config COAP_WIFI_SSID
        string "Wi-Fi SSID"
        default "Minh Toan"
        help
            SSID of the Access Point to connect to for CoAP.

    config COAP_WIFI_PASSWORD
        string "Wi-Fi Password"
        default "21012004"
        help
            Password of the Access Point to connect to.

    config COAP_MAX_RETRY
        int "Maximum Wi-Fi Connection Retries"
        default 10
        help
            Number of retries before reporting Wi-Fi connection failure.

    config COAP_PORT
        int "CoAP UDP Port"
        default 5683
        help
            Standard port for CoAP over UDP (default: 5683).

    config COAP_DTLS_PORT
        int "CoAPS DTLS Port"
        default 5684
        help
            Standard port for CoAP over DTLS (default: 5684).

    config COAP_PSK_KEY
        string "CoAPS DTLS Pre-Shared Key (PSK)"
        default "esp32c3_key"
        help
            Pre-shared key used for secure CoAPS communication.

endmenu
```

## test_case/gatt_server/sdkconfig.defaults
```kconfig
# Espressif IoT Development Framework (ESP-IDF) Project Configuration
CONFIG_IDF_TARGET="esp32c3"
CONFIG_IDF_TARGET_ESP32C3=y

# Serial flasher config
CONFIG_ESPTOOLPY_FLASHSIZE_4MB=y
CONFIG_PARTITION_TABLE_CUSTOM=y
CONFIG_PARTITION_TABLE_CUSTOM_FILENAME="partitions.csv"
CONFIG_PARTITION_TABLE_FILENAME="partitions.csv"
CONFIG_PARTITION_TABLE_OFFSET=0x8000
CONFIG_PARTITION_TABLE_MD5=y

# Bluetooth Configuration (Section 8.5.3)
CONFIG_BT_ENABLED=y
CONFIG_BTDM_CTRL_MODE_BLE_ONLY=y
CONFIG_BTDM_CTRL_MODE_BR_EDR_ONLY=n
CONFIG_BTDM_CTRL_MODE_BTDM=n
CONFIG_BT_BLUEDROID_ENABLED=y
CONFIG_BT_BLE_42_FEATURES_SUPPORTED=y
```

## test_case/https_server/main/Kconfig.projbuild
```kconfig
menu "HTTPS Server Configuration"

    config HTTPS_SERVER_WIFI_SSID
        string "Wi-Fi SSID"
        default "Minh Toan"
        help
            SSID of the Access Point to connect to for Web Server.

    config HTTPS_SERVER_WIFI_PASSWORD
        string "Wi-Fi Password"
        default "21012004"
        help
            Password of the Access Point to connect to.

    config HTTPS_SERVER_MAX_RETRY
        int "Maximum Wi-Fi Connection Retries"
        default 5
        help
            Number of retries before reporting Wi-Fi connection failure.

    config HTTPS_SERVER_SUPPORT_TLS
        bool "Enable TLS / HTTPS Server (Port 443)"
        default y
        help
            When enabled, starts HTTPS Server with SSL/TLS encryption on Port 443.
            When disabled, starts standard HTTP Server on Port 80.

    config HTTPS_SERVER_PORT_HTTP
        int "HTTP Server Port"
        default 80
        help
            Port for unencrypted HTTP Web Server.

    config HTTPS_SERVER_PORT_HTTPS
        int "HTTPS Server Port"
        default 443
        help
            Port for TLS-encrypted HTTPS Server.

endmenu
```

## test_case/https_server/sdkconfig.defaults
```kconfig
# Espressif IoT Development Framework (ESP-IDF) Project Configuration
CONFIG_IDF_TARGET="esp32c3"
CONFIG_IDF_TARGET_ESP32C3=y

# Serial flasher config
CONFIG_ESPTOOLPY_FLASHSIZE_4MB=y
CONFIG_PARTITION_TABLE_SINGLE_APP=n
CONFIG_PARTITION_TABLE_TWO_OTA=n
CONFIG_PARTITION_TABLE_CUSTOM=y
CONFIG_PARTITION_TABLE_CUSTOM_FILENAME="partitions.csv"
CONFIG_PARTITION_TABLE_FILENAME="partitions.csv"
CONFIG_PARTITION_TABLE_OFFSET=0x8000
CONFIG_PARTITION_TABLE_MD5=y

# HTTPS Server Configuration
CONFIG_ESP_HTTPS_SERVER_ENABLE=y
CONFIG_HTTPD_MAX_REQ_HDR_LEN=2048
CONFIG_MBEDTLS_DYNAMIC_BUFFER=y
CONFIG_ESP_MAIN_TASK_STACK_SIZE=8192

# Default Wi-Fi Credentials for testing
CONFIG_HTTPS_SERVER_WIFI_SSID="Minh Toan"
CONFIG_HTTPS_SERVER_WIFI_PASSWORD="21012004"
CONFIG_HTTPS_SERVER_SUPPORT_TLS=y
```

## test_case/local_control/main/Kconfig.projbuild
```kconfig
menu "Local Control Configuration"

    config LOCAL_CTRL_WIFI_SSID
        string "Wi-Fi SSID"
        default "MyHomeWiFi"
        help
            SSID of the Access Point to connect to for Local Control over LAN.

    config LOCAL_CTRL_WIFI_PASSWORD
        string "Wi-Fi Password"
        default "12345678"
        help
            Password of the Access Point to connect to.

    config LOCAL_CTRL_MAXIMUM_RETRY
        int "Maximum Wi-Fi Connection Retries"
        default 5
        help
            Number of retries before reporting Wi-Fi connection failure.

    config LOCAL_CTRL_MDNS_HOST_NAME
        string "mDNS Hostname for Local HTTPS Control"
        default "my_esp_ctrl_device"
        help
            Local domain name advertised via mDNS (e.g. my_esp_ctrl_device.local).

    config LOCAL_CTRL_BLE_ENABLE
        bool "Enable Fallback Bluetooth LE Local Control (GATT Server)"
        default n
        help
            Enables standalone Bluetooth LE GATT Server for offline local control
            when Wi-Fi router is offline or unreachable (Section 8.5.3).

    config LOCAL_CTRL_BLE_DEVICE_NAME
        string "Bluetooth LE Device Advertisement Name"
        depends on LOCAL_CTRL_BLE_ENABLE
        default "ESP32-LOCAL-LIGHT"
        help
            Device name advertised over Bluetooth LE for local smartphone scanning.

endmenu
```

## test_case/mdns_discovery/main/Kconfig.projbuild
```kconfig
menu "mDNS Discovery Configuration"

    config MDNS_WIFI_SSID
        string "Wi-Fi SSID"
        default "Minh Toan"
        help
            SSID of the Access Point to connect to for mDNS Discovery.

    config MDNS_WIFI_PASSWORD
        string "Wi-Fi Password"
        default "21012004"
        help
            Password of the Access Point to connect to.

    config MDNS_MAX_RETRY
        int "Maximum Wi-Fi Connection Retries"
        default 10
        help
            Number of retries before reporting Wi-Fi connection failure.

    config MDNS_HOSTNAME
        string "mDNS Hostname"
        default "my_smart_light"
        help
            Hostname for local resolution (e.g., my_smart_light -> my_smart_light.local).

    config MDNS_INSTANCE_NAME
        string "mDNS Instance Name"
        default "esp32c3_smart_light"
        help
            Friendly service instance name advertised across the local network.

    config MDNS_SERVICE_PORT
        int "mDNS Advertised HTTP Port"
        default 80
        help
            Port number advertised for the _http._tcp service.

endmenu
```

## test_case/multicast_discovery/main/Kconfig.projbuild
```kconfig
menu "Multicast Discovery Configuration"

    config MULTICAST_WIFI_SSID
        string "Wi-Fi SSID"
        default "Minh Toan"
        help
            SSID of the Access Point to connect to for Multicast Discovery.

    config MULTICAST_WIFI_PASSWORD
        string "Wi-Fi Password"
        default "21012004"
        help
            Password of the Access Point to connect to.

    config MULTICAST_MAX_RETRY
        int "Maximum Wi-Fi Connection Retries"
        default 10
        help
            Number of retries before reporting Wi-Fi connection failure.

    config MULTICAST_IPV4_ADDR
        string "Multicast IPv4 Group Address"
        default "232.10.11.12"
        help
            Class D Multicast group address (e.g., 232.10.11.12 or 239.255.255.250).

    config MULTICAST_PORT
        int "UDP Multicast Discovery Port"
        default 3333
        help
            UDP port used for multicast communication (default: 3333).

    config MULTICAST_TTL
        int "Multicast Packet TTL (Time to Live)"
        default 1
        range 1 255
        help
            IP_MULTICAST_TTL value. 1 restricts packets to the local subnet.

    config MULTICAST_IS_CLIENT
        bool "Run as Multicast Client/Sender (Default is Device/Receiver)"
        default n
        help
            When enabled, sends multicast query packets to discover lights.
            When disabled (default), listens and joins group as Smart Light device.

endmenu
```

## test_case/tcp_socket/main/Kconfig.projbuild
```kconfig
menu "TCP Socket Configuration"

    config TCP_WIFI_SSID
        string "Wi-Fi SSID"
        default "Minh Toan"
        help
            SSID of the Access Point to connect to for TCP Socket.

    config TCP_WIFI_PASSWORD
        string "Wi-Fi Password"
        default "21012004"
        help
            Password of the Access Point to connect to.

    config TCP_MAX_RETRY
        int "Maximum Wi-Fi Connection Retries"
        default 10
        help
            Number of retries before reporting Wi-Fi connection failure.

    config TCP_PORT
        int "TCP Server Port"
        default 3333
        help
            Port number for TCP Server to listen on (default: 3333).

    config TCP_IS_CLIENT
        bool "Run as TCP Client (Default is TCP Server / Smart Light)"
        default n
        help
            When enabled, acts as client connecting to a remote TCP Server.
            When disabled (default), acts as TCP Server receiving commands.

    config TCP_SERVER_HOST
        string "Remote TCP Server IP (for Client mode)"
        default "192.168.1.100"
        depends on TCP_IS_CLIENT
        help
            Remote IPv4 address to connect to when running in client mode.

endmenu
```
